## sdkconfig.defaults
```kconfig
CONFIG_DEFAULT_WIFI_SSID=""
CONFIG_DEFAULT_WIFI_PASSWORD=""
CONFIG_SERVER_ADDRESS=""
CONFIG_WEATHER_API_KEY=""
CONFIG_CODING_PLAN_API_TOKEN=""
CONFIG_CAR_MOVE_PHONE_NUMBER=""

# Compiler / optimization
CONFIG_COMPILER_OPTIMIZATION_SIZE=y
CONFIG_COMPILER_OPTIMIZATION_ASSERTIONS_SILENT=y
CONFIG_COMPILER_OPTIMIZATION_ASSERTION_LEVEL=1

# Bootloader
CONFIG_BOOTLOADER_COMPILER_OPTIMIZATION_PERF=y
CONFIG_BOOTLOADER_LOG_LEVEL_NONE=y
CONFIG_BOOTLOADER_SKIP_VALIDATE_ALWAYS=y
CONFIG_BOOTLOADER_APP_ROLLBACK_ENABLE=y

# Flash / partition table (16MB ZecTrix-S3 board)
CONFIG_ESPTOOLPY_FLASHSIZE_16MB=y
CONFIG_ESPTOOLPY_FLASHSIZE="16MB"
CONFIG_PARTITION_TABLE_CUSTOM=y
CONFIG_PARTITION_TABLE_CUSTOM_FILENAME="partitions/v2/16m.csv"
CONFIG_PARTITION_TABLE_OFFSET=0x8000

# Bluetooth (Bluedroid — BLE GATT image push + NFC Touch & Go)
CONFIG_BT_ENABLED=y
CONFIG_BT_BLUEDROID_ENABLED=y
CONFIG_BT_BLE_ENABLED=y

# SPIRAM (Octal PSRAM, 80MHz)
CONFIG_SPIRAM=y
CONFIG_SPIRAM_MODE_OCT=y
CONFIG_SPIRAM_SPEED_80M=y
CONFIG_SPIRAM_MALLOC_ALWAYSINTERNAL=512
CONFIG_SPIRAM_MALLOC_RESERVE_INTERNAL=65536
CONFIG_SPIRAM_ALLOW_BSS_SEG_EXTERNAL_MEMORY=y
CONFIG_SPIRAM_ALLOW_STACK_EXTERNAL_MEMORY=y

# CPU frequency
CONFIG_ESP_DEFAULT_CPU_FREQ_MHZ_240=y

# Task stacks / WDT
CONFIG_ESP_MAIN_TASK_STACK_SIZE=8192
CONFIG_ESP_SYSTEM_EVENT_TASK_STACK_SIZE=4096
CONFIG_ESP_TASK_WDT_TIMEOUT_S=10

# HTTP server (AP transfer server needs larger headers)
CONFIG_HTTPD_MAX_REQ_HDR_LEN=2048
CONFIG_HTTPD_MAX_URI_LEN=2048

# WiFi (memory-optimised for this board)
CONFIG_ESP_WIFI_STATIC_RX_BUFFER_NUM=3
CONFIG_ESP_WIFI_DYNAMIC_RX_BUFFER_NUM=6
CONFIG_ESP_WIFI_DYNAMIC_RX_MGMT_BUFFER=y
CONFIG_ESP_WIFI_RX_BA_WIN=3

# LWIP
CONFIG_LWIP_TCPIP_TASK_STACK_SIZE=16384

# mbedTLS (dynamic buffers to save memory)
CONFIG_MBEDTLS_DYNAMIC_BUFFER=y
CONFIG_MBEDTLS_DYNAMIC_FREE_CONFIG_DATA=y
CONFIG_MBEDTLS_EXTERNAL_MEM_ALLOC=y

# Core dump
CONFIG_ESP_COREDUMP_ENABLE_TO_NONE=y

# FreeRTOS stats
CONFIG_FREERTOS_GENERATE_RUN_TIME_STATS=y
CONFIG_FREERTOS_USE_STATS_FORMATTING_FUNCTIONS=y

# LVGL 9.x
CONFIG_LV_OS_NONE=y
CONFIG_LV_USE_CLIB_MALLOC=y
CONFIG_LV_USE_CLIB_STRING=y
CONFIG_LV_USE_CLIB_SPRINTF=y
CONFIG_LV_USE_ASSERT_STYLE=y
CONFIG_LV_FONT_FMT_TXT_LARGE=y
CONFIG_LV_USE_LIST=y
CONFIG_LV_USE_TABVIEW=y
CONFIG_LV_USE_LODEPNG=y
CONFIG_LV_USE_SNAPSHOT=y
CONFIG_LV_USE_IMGFONT=y
```
